## software_esp32/main/Kconfig.projbuild
```kconfig
menu "Golioth Example Configuration"

config GOLIOTH_BLE_SERVICE_ENABLED
    bool "Enable BLE provisioning service"
    depends on BT_NIMBLE_ENABLED
    default n
    help
        Enables the NimBLE stack and executes a GATT
        server that serves a provisioning service for
        settings WiFi and Golioth credentials.

endmenu

menu "SCD30 configuration"
    config SCD30_I2C_MASTER_SCL
        int "SCL GPIO Number"
        default 5 if IDF_TARGET_ESP8266
        default 6 if IDF_TARGET_ESP32C3
        default 19 if IDF_TARGET_ESP32 || IDF_TARGET_ESP32S2 || IDF_TARGET_ESP32S3
        help
            GPIO number for I2C Master clock line.

    config SCD30_I2C_MASTER_SDA
        int "SDA GPIO Number"
        default 4 if IDF_TARGET_ESP8266
        default 5 if IDF_TARGET_ESP32C3
        default 18 if IDF_TARGET_ESP32 || IDF_TARGET_ESP32S2 || IDF_TARGET_ESP32S3
        help
            GPIO number for I2C Master data line.
endmenu
```

## v4/software/managed_components/libnmea-esp32/example/main/Kconfig.projbuild
```kconfig
menu "libnmea Example Settings"

    choice EXAMPLE_NMEA_INTERFACE
        prompt "Interface to connect the GPS over"
        default EXAMPLE_NMEA_INTERFACE_UART

        config EXAMPLE_NMEA_INTERFACE_UART
            bool "UART"

        config EXAMPLE_NMEA_INTERFACE_I2C
            bool "I2C"

    endchoice

    if EXAMPLE_NMEA_INTERFACE_UART
        config EXAMPLE_UART_NUM
            int "UART port number"
            default 1

        config EXAMPLE_UART_RX
            int "UART RX GPIO number"
            default 21
    endif

    if EXAMPLE_NMEA_INTERFACE_I2C
        config EXAMPLE_I2C_NUM
            int "I2C port number"
            default 0
        config EXAMPLE_I2C_SDA_PIN
            int "I2C SDA GPIO number"
            default 24
        config EXAMPLE_I2C_SCL_PIN
            int "I2C SCL GPIO number"
            default 25
        config EXAMPLE_I2C_SLAVE_ADDR
            hex "I2C address of the GPS"
            default 0x10
    endif


endmenu
```

## v4/software/sdkconfig.defaults
```kconfig
CONFIG_MBEDTLS_SSL_PROTO_DTLS=y
CONFIG_MBEDTLS_PSK_MODES=y
CONFIG_MBEDTLS_KEY_EXCHANGE_PSK=y
CONFIG_LWIP_NETBUF_RECVINFO=y
CONFIG_FREERTOS_USE_TRACE_FACILITY=y
CONFIG_FREERTOS_USE_STATS_FORMATTING_FUNCTIONS=y

# Default sdkconfig parameters to use the OTA
# partition table layout, with a 4MB flash size
CONFIG_ESPTOOLPY_FLASHSIZE_4MB=y
CONFIG_PARTITION_TABLE_TWO_OTA=y

# If the new app firmware does not cancel the rollback,
# then this will ensure that rollback happens automatically
# if/when the device is next rebooted.
CONFIG_BOOTLOADER_APP_ROLLBACK_ENABLE=y
```
